## examples/recorder/pipeline_raw_a2dp/main/Kconfig.projbuild
```kconfig
menu "Example Configuration"

config BT_REMOTE_NAME
    string "BT remote device name"
	default "ESP-ADF-AUDIO"
	help
		BT_REMOTE_NAME (Bluetooth device name) for the example to connect to.

endmenu
```
